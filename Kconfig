## Kconfig
```kconfig
menu "QP Embedded Framework"
  config QP_ENABLED
    bool "QP Real-Time Embedded Framework"
    help
      Select this option to enable QPC Framework

  menu "QPC Configuration"
    visible if QP_ENABLED
    choice QPC_PINNED_TO_CORE_CHOICE
      prompt "The cpu core which QPC run"
      depends on !FREERTOS_UNICORE
      help
        Specify the cpu core to run QPC.
      config QPC_PINNED_TO_CORE_0
        bool "Core 0 (PRO CPU)"
      config QPC_PINNED_TO_CORE_1
        bool "Core 1 (APP CPU)"
      config QPC_NO_CORE_AFFINITY
        bool "No Affinity (PRO or APP CPU)"
    endchoice #QPC_PINNED_TO_CORE_CHOICE

    menu "Event Memory Pool"
      visible if QP_ENABLED
      config QPC_SMALL_POOL_SIZE
        int "Small Memory Pool Size"
        depends on QP_ENABLED
        range 16 512
        default 32
        help
          Max number of events in a small memory pool
      config QPC_MEDIUM_POOL_SIZE
        int "Medium Memory Pool Size"
        depends on QP_ENABLED
        range 16 512
        default 32
        help
          Max number of events in a medium memory pool
      config QPC_LARGE_POOL_SIZE
        int "Large Memory Pool Size"
        depends on QP_ENABLED
        range 16 512
        default 32
        help
          Max number of events in a large memory pool
    endmenu #"Event Memory Pool"

  endmenu #QPC Configuration

endmenu
```
